## yoctoproject/meta-container/conf/distro/poky-container.conf
```bitbake
require conf/distro/poky.conf

TCLIBC = "musl"

VIRTUAL-RUNTIME_dev_manager = ""
VIRTUAL-RUNTIME_login_manager = ""
VIRTUAL-RUNTIME_init_manager = ""
VIRTUAL-RUNTIME_initscripts = ""
VIRTUAL-RUNTIME_keymaps = ""

# These changes probably belong in a machine.conf _but_ we want to be able
# to reuse as much of the public sstate as possible, so we do it in the distro
# and that way can use existing built toolchains
PREFERRED_PROVIDER_virtual/kernel = "linux-dummy"
MACHINE_ESSENTIAL_EXTRA_RDEPENDS = ""
```

## yoctoproject/meta-container/conf/layer.conf
```bitbake
# We have a conf and classes directory, add to BBPATH
BBPATH .= ":${LAYERDIR}"

# We have recipes-* directories, add to BBFILES
BBFILES += "${LAYERDIR}/recipes-*/*/*.bb \
            ${LAYERDIR}/recipes-*/*/*.bbappend"

BBFILE_COLLECTIONS += "meta-container"
BBFILE_PATTERN_meta-container = "^${LAYERDIR}/"
BBFILE_PRIORITY_meta-container = "6"

LAYERDEPENDS_meta-container = "core"
LAYERSERIES_COMPAT_meta-container = "warrior"
```
